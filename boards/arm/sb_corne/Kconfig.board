## boards/arm/sb_corne/Kconfig.board
```kconfig
#
# Copyright (c) 2024 The ZMK Contributors
# SPDX-License-Identifier: MIT
#

config BOARD_SB_CORNE_LEFT
    bool "sb_corne left"
    depends on SOC_NRF52840_QIAA

config BOARD_SB_CORNE_RIGHT
    bool "sb_corne right"
    depends on SOC_NRF52840_QIAA
```

## boards/arm/sb_nice_view/Kconfig.board
```kconfig
#
# Copyright (c) 2024 The ZMK Contributors
# SPDX-License-Identifier: MIT
#

config BOARD_SB_NICE_VIEW_LEFT
    bool "sb_nice_view left"
    depends on SOC_NRF52840_QIAA

config BOARD_SB_NICE_VIEW_RIGHT
    bool "sb_nice_view right"
    depends on SOC_NRF52840_QIAA
```

## boards/arm/sb_nice_view/Kconfig.defconfig
```kconfig
#
# Copyright (c) 2024 The ZMK Contributors
# SPDX-License-Identifier: MIT
#

if BOARD_SB_NICE_VIEW_LEFT

config ZMK_KEYBOARD_NAME
    default "SB Nice View Corne"

config ZMK_SPLIT_ROLE_CENTRAL
    default y

endif # BOARD_SB_NICE_VIEW_LEFT

if BOARD_SB_NICE_VIEW_LEFT || BOARD_SB_NICE_VIEW_RIGHT

config BOARD
    default "sb_nice_view"

config BOARD_ENABLE_DCDC
    bool "Enable DCDC mode"
    select SOC_DCDC_NRF52X
    default y

config BOARD_ENABLE_DCDC_HV
    bool "Enable High Voltage DCDC converter"
    default y
    select SOC_DCDC_NRF52X_HV
    depends on (BOARD_SB_NICE_VIEW_LEFT || BOARD_SB_NICE_VIEW_RIGHT)

config ZMK_SLEEP
    default y

config ZMK_SPLIT
    default y

config BT_CTLR
    default BT

if USB

config USB_NRFX
    default y

config USB_DEVICE_STACK
    default y

endif # USB

if ZMK_BACKLIGHT

config PWM
    default y

config LED_PWM
    default y

endif # ZMK_BACKLIGHT

endif # BOARD_SB_NICE_VIEW_LEFT || BOARD_SB_NICE_VIEW_RIGHT
```
